## boards/arm/blackpill_f403acg/Kconfig.board
```kconfig
# Copyright (c) 2024 Rick Bruyninckx
# SPDX-License-Identifier: Apache-2.0

# AT32F403ACGU7 based Black Pill V1.0 board configuration

config BOARD_BLACKPILL_F403ACG
	bool "WeAct Studio Black Pill V1.0 Board"
	depends on SOC_STM32F401XC
```

## boards/arm/blackpill_f403acg/Kconfig.defconfig
```kconfig
# Copyright (c) 2024 Rick Bruyninckx
# SPDX-License-Identifier: Apache-2.0

# AT32F403ACGU7 based Black Pill V1.0 board board configuration

if BOARD_BLACKPILL_F403ACG

config BOARD
	default "blackpill_f403acg"

config SPI_STM32_INTERRUPT
	default y
	depends on SPI

endif # BOARD_BLACKPILL_F403ACG
```

## drivers/sensor/ad7156/Kconfig
```kconfig
# AD7156 capacitance converter configuration options

# Copyright (c) 2023 Sensorfy B.V.
# SPDX-License-Identifier: Apache-2.0

menuconfig AD7156
	bool "AD7156 Capacitance Converter"
	default y
	depends on DT_HAS_ADI_AD7156_ENABLED
	select I2C
	help
	  Enable the driver for Analog Devices Ultralow Power
	  2-Channel Capacitance Converter

if AD7156

choice
	prompt "Trigger mode"
	default AD7156_TRIGGER_NONE
	help
	  Specify the type of triggering used by the driver.

config AD7156_TRIGGER_NONE
	bool "No trigger"

config AD7156_TRIGGER_GLOBAL_THREAD
	bool "Use global thread"
	depends on GPIO
	select AD7156_TRIGGER

config AD7156_TRIGGER_OWN_THREAD
	bool "Use own thread"
	depends on GPIO
	select AD7156_TRIGGER

endchoice

config AD7156_TRIGGER
	bool

config AD7156_THREAD_PRIORITY
	int "Thread priority"
	depends on AD7156_TRIGGER_OWN_THREAD && AD7156_TRIGGER
	default 10
	help
	  Priority of thread used by the driver to handle interrupts.

config AD7156_THREAD_STACK_SIZE
	int "Thread stack size"
	depends on AD7156_TRIGGER_OWN_THREAD && AD7156_TRIGGER
	default 1024
	help
	  Stack size of thread used by the driver to handle interrupts.

endif # AD7156
```

## dts/bindings/lora/st,stm32wl-subghz-radio.yaml
```yaml
# Copyright (c) 2021 Fabio Baltieri
# SPDX-License-Identifier: Apache-2.0

description: STM32WL SUBGHZ Radio

compatible: "st,stm32wl-subghz-radio"

include: semtech,sx126x-base.yaml

properties:
    interrupts:
      required: true
      description: |
        Position of the "Radio IRQ, Busy" interrupt line.

    power-amplifier-output:
      type: string
      required: true
      description: |
        Selects between the low- and high-power power amplifier output pin.
      enum:
        - "rfo-lp"
        - "rfo-hp"

    rfo-lp-max-power:
      type: int
      default: 15
      description: |
        Maximum design power for the board's RFO_LP output matching network.
      enum:
        - 10
        - 14
        - 15

    rfo-hp-max-power:
      type: int
      default: 22
      description: |
        Maximum design power for the board's RFO_HP output matching network.
      enum:
        - 14
        - 17
        - 20
        - 22
```

## dts/bindings/sensor/adi,ad7156.yaml
```yaml
description: AD7156 2-Channel Capacitance Converter

compatible: "adi,ad7156"

include: [sensor-device.yaml, i2c-device.yaml]

properties:
  int-gpios:
    type: phandle-array
    description: |
      The OUTx signals defaults to active high as produced by the
      sensor.  The property value should ensure the flags properly
      describe the signal that is presented to the driver.
```
